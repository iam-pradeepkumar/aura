## firmware/aura_rx/main/Kconfig.projbuild
```kconfig
menu "AURA RX Configuration"

    config AURA_NODE_ID
        int "ESP32 RX node ID (unique per board)"
        range 1 8
        default 1
        help
            Set a different ID for each receiver board (1-4 for corner deployment).

endmenu
```

## firmware/aura_tx/sdkconfig.defaults
```kconfig
CONFIG_ESP_WIFI_CSI_ENABLED=y
CONFIG_ESP_WIFI_STATIC_RX_BUFFER_NUM=16
CONFIG_ESP_WIFI_DYNAMIC_RX_BUFFER_NUM=64
CONFIG_FREERTOS_HZ=1000
```
